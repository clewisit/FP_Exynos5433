## drivers/devfreq/Kconfig
```kconfig
menuconfig PM_DEVFREQ
	bool "Generic Dynamic Voltage and Frequency Scaling (DVFS) support"
	help
	  A device may have a list of frequencies and voltages available.
	  devfreq, a generic DVFS framework can be registered for a device
	  in order to let the governor provided to devfreq choose an
	  operating frequency based on the device driver's policy.

	  Each device may have its own governor and policy. Devfreq can
	  reevaluate the device state periodically and/or based on the
	  notification to "nb", a notifier block, of devfreq.

	  Like some CPUs with CPUfreq, a device may have multiple clocks.
	  However, because the clock frequencies of a single device are
	  determined by the single device's state, an instance of devfreq
	  is attached to a single device and returns a "representative"
	  clock frequency of the device, which is also attached
	  to a device by 1-to-1. The device registering devfreq takes the
	  responsibility to "interpret" the representative frequency and
	  to set its every clock accordingly with the "target" callback
	  given to devfreq.

	  When OPP is used with the devfreq device, it is recommended to
	  register devfreq's nb to the OPP's notifier head.  If OPP is
	  used with the devfreq device, you may use OPP helper
	  functions defined in devfreq.h.

if PM_DEVFREQ

comment "DEVFREQ Governors"

config DEVFREQ_GOV_SIMPLE_ONDEMAND
	tristate "Simple Ondemand"
	help
	  Chooses frequency based on the recent load on the device. Works
	  similar as ONDEMAND governor of CPUFREQ does. A device with
	  Simple-Ondemand should be able to provide busy/total counter
	  values that imply the usage rate. A device may provide tuned
	  values to the governor with data field at devfreq_add_device().

config DEVFREQ_GOV_SIMPLE_USAGE
	tristate "Simple Usage"
	help
	  Chooses frequency based on the percentage of target device.

config DEVFREQ_GOV_SIMPLE_EXYNOS
	tristate "Simple Exynos"
	help
	  Chooses frequency based on the threshold of target device.

config DEVFREQ_GOV_PERFORMANCE
	tristate "Performance"
	help
	  Sets the frequency at the maximum available frequency.
	  This governor always returns UINT_MAX as frequency so that
	  the DEVFREQ framework returns the highest frequency available
	  at any time.

config DEVFREQ_GOV_POWERSAVE
	tristate "Powersave"
	help
	  Sets the frequency at the minimum available frequency.
	  This governor always returns 0 as frequency so that
	  the DEVFREQ framework returns the lowest frequency available
	  at any time.

config DEVFREQ_GOV_USERSPACE
	tristate "Userspace"
	help
	  Sets the frequency at the user specified one.
	  This governor returns the user configured frequency if there
	  has been an input to /sys/devices/.../power/devfreq_set_freq.
	  Otherwise, the governor does not change the frequnecy
	  given at the initialization.

config DEVFREQ_GOV_MSM_ADRENO_TZ
	tristate "MSM Adreno Trustzone"
	depends on MSM_KGSL && MSM_SCM
	help
	  Trustzone based governor for the Adreno GPU.
	  Sets the frequency using a "on-demand" algorithm.
	  This governor is unlikely to be useful for other devices.

config ADRENO_IDLER
	tristate "MSM Adreno idler"
	depends on DEVFREQ_GOV_MSM_ADRENO_TZ
	help
	  Uses a different calculation method on top of Adreno TZ
	  just for calculating frequency for idle to reduce the
	  wasted power coming from stock Adreno TZ while
	  maintaining high-performance.

config DEVFREQ_GOV_MSM_CPUFREQ
	bool "MSM CPUfreq"
	depends on CPU_FREQ_MSM
	help
	  MSM CPUfreq based governor for CPU bandwidth voting.  Sets the CPU
	  to DDR BW vote based on the current CPU frequency.  This governor
	  is unlikely to be useful for non-MSM devices.

config DEVFREQ_GOV_MSM_BW_HWMON
	tristate "HW monitor based governor for device BW"
	depends on ARCH_MSM_KRAIT
	help
	  HW monitor based governor for device to DDR bandwidth voting.

	  When this governor is used for Krait CPUs, it sets the Krait CPU BW
	  vote by using L2 PM counters to monitor the Krait's use of DDR.
	  Since this uses some of the Krait PM counters it can conflict with
	  existing profiling tools.  This governor is unlikely to be useful
	  for non-MSM devices.

config DEVFREQ_GOV_MSM_CACHE_HWMON
	tristate "HW monitor based governor for cache frequency"
	help
	  HW monitor based governor for cache frequency scaling. This
	  governor currently supports only Krait L2 PM counters.  Sets the
	  cache frequency by using L2 PM counters to monitor the Krait's use
	  of the L2.  Since this governor uses some of the PM counters it can
	  conflict with existing profiling tools.  This governor is unlikely
	  to be useful for other devices.

config SIMPLE_GPU_ALGORITHM
	bool "Simple GPU algorithm"
	depends on DEVFREQ_GOV_MSM_ADRENO_TZ
	help
	  Simple user configurable GPU controlling algorithm

comment "DEVFREQ Drivers"

config ARM_EXYNOS4_BUS_DEVFREQ
	bool "ARM Exynos4210/4212/4412 Memory Bus DEVFREQ Driver"
	depends on CPU_EXYNOS4210 || CPU_EXYNOS4212 || CPU_EXYNOS4412
	select ARCH_HAS_OPP
	select DEVFREQ_GOV_SIMPLE_ONDEMAND
	help
	  This adds the DEVFREQ driver for Exynos4210 memory bus (vdd_int)
	  and Exynos4212/4412 memory interface and bus (vdd_mif + vdd_int).
	  It reads PPMU counters of memory controllers and adjusts
	  the operating frequencies and voltages with OPP support.
	  To operate with optimal voltages, ASV support is required
	  (CONFIG_EXYNOS_ASV).

config ARM_EXYNOS5422_BUS_DEVFREQ
	bool "ARM Exynos5422 Memory Bus DEVFREQ Driver"
	depends on SOC_EXYNOS5422
	select ARCH_HAS_OPP
	select PM_OPP
	select DEVFREQ_GOV_SIMPLE_ONDEMAND
	help
	  This adds the DEVFREQ driver for Exynos5 series memory and int.

config ARM_EXYNOS5430_BUS_DEVFREQ
	bool "ARM Exynos5430 Memory Bus DEVFREQ Driver"
	depends on SOC_EXYNOS5430
	select ARCH_HAS_OPP
	select PM_OPP
	select DEVFREQ_GOV_SIMPLE_ONDEMAND
	help
	  This adds the DEVFREQ driver for Exynos5 series memory and int.

config ARM_EXYNOS5433_BUS_DEVFREQ
	bool "ARM Exynos5433 Memory Bus DEVFREQ Driver"
	default y
	depends on SOC_EXYNOS5433
	select ARCH_HAS_OPP
	select PM_OPP
	select DEVFREQ_GOV_SIMPLE_ONDEMAND
	select DEVFREQ_GOV_SIMPLE_EXYNOS
	help
	  This adds the DEVFREQ driver for Exynos5 series memory and int.

choice
	prompt "ARM Exynos5430 DEVFREQ Driver for CAM"
	depends on ARM_EXYNOS5430_BUS_DEVFREQ
	default ARM_EXYNOS5430_BUS_DEVFREQ_CAM_16M

config ARM_EXYNOS5430_BUS_DEVFREQ_CAM_16M
	bool "ARM Exynos5430 DEVFREQ for CAM 16M"
	depends on ARM_EXYNOS5430_BUS_DEVFREQ
	help
	 This adds the DVFS table for CAM 16M

config ARM_EXYNOS5430_BUS_DEVFREQ_CAM_13M
	bool "ARM Exynos5430 DEVFREQ for CAM 13M"
	depends on ARM_EXYNOS5430_BUS_DEVFREQ
	help
	 This adds the DVFS table for CAM 13M
endchoice

choice
	prompt "ARM Exynos5433 DEVFREQ Driver for CAM"
	depends on ARM_EXYNOS5433_BUS_DEVFREQ
	default ARM_EXYNOS5433_BUS_DEVFREQ_CAM_16M

config ARM_EXYNOS5433_BUS_DEVFREQ_CAM_16M
	bool "ARM Exynos5433 DEVFREQ for CAM 16M"
	depends on ARM_EXYNOS5433_BUS_DEVFREQ
	help
	 This adds the DVFS table for CAM 16M

config ARM_EXYNOS5433_BUS_DEVFREQ_CAM_13M
	bool "ARM Exynos5433 DEVFREQ for CAM 13M"
	depends on ARM_EXYNOS5433_BUS_DEVFREQ
	help
	 This adds the DVFS table for CAM 13M
endchoice

config ARM_EXYNOS_BUS_DEVFREQ_SYSFS_MAX_TEMP
	bool "ARM Exynos Sysfs Max Temperature Level"
	depends on (ARM_EXYNOS5430_BUS_DEVFREQ || ARM_EXYNOS5433_BUS_DEVFREQ)
	help
	 This option expose sysfs which show max temperature level

config ARM_EXYNOS5433_BUS_DEVFREQ_TEMP_INT_MINLOCK
	bool "Temprorary 400Mhz Int freq minlock for Tab S2"
	default n
	help
	 This option is temproray 400MHz Int freq minlock.

config ARM_EXYNOS5433_BUS_DEVFREQ_THERMAL_POLICY_3_4
	bool "change thermal policy (3/4x)"
	depends on ARM_EXYNOS5433_BUS_DEVFREQ
	default n
	help
	  - change MR4 default polling period : 1000msec --> 300msec
	  - change default AREF rate : 1x --> 3/4x

endif # PM_DEVFREQ
```
